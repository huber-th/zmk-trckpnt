## config/boards/shields/trckpnt/Kconfig.defconfig
```kconfig
# Copyright (c) 2020 The ZMK Contributors
# SPDX-License-Identifier: MIT

if TRCKPNT

config ZMK_KEYBOARD_NAME
    default "trckpnt"

endif
```

## config/boards/shields/trckpnt/Kconfig.shield
```kconfig
# Copyright (c) 2020 The ZMK Contributors
# SPDX-License-Identifier: MIT

config TRCKPNT
    def_bool $(shields_list_contains,trckpnt)
```
